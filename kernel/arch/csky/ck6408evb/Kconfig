## kernel/arch/csky/ck6408evb/Kconfig
```kconfig
# arch/csky/ck6408evb/Kconfig
#
# Copyright (C) 2009, C-SKY Microsystems Co., Ltd. (www.c-sky.com) 
#
# Licensed under GPLv2

if CK6408EVB

config PLAT_TRILOBITE_V9
        bool "Platform trilobite v9-1"
        default n
        ---help---
           the platform trilobite v9-1 use new mac(stmmac) and new usbhost.
           if unsure, say N.

endif
```

## kernel/drivers/media/dvb/silan/Kconfig
```kconfig
config DVB_XPU
	tristate "SILAN XPU DVB"
	depends on DVB_CORE && I2C
	help
	  Support for DVB receivers from Tuner
	  
	  These devices don't have an MPEG decoder built in,
	  so you need an external software decoder to watch TV.

	  To compile this driver as a module, say M here:
	  the module will be called XPU DVB.
```

## kernel/drivers/net/stmmac/Kconfig
```kconfig
config STMMAC_ETH
	tristate "STMicroelectronics 10/100/1000 Ethernet driver"
	select MII
	select PHYLIB
	select CRC32
	depends on NETDEVICES && HAS_IOMEM
	help
	  This is the driver for the Ethernet IPs are built around a
	  Synopsys IP Core and only tested on the STMicroelectronics
	  platforms.

if STMMAC_ETH

config SILAN_GMAC_TX_POSTCHK
    bool "Silan GMAC Tx enhancement: Tx completion post-check"
    default n
    help
        Tx post-check with Tx interrupt disabled, which reduces interrupts
        to the OS. Different from doing the Tx completion work when Tx complete
        interrupt is received, Tx post-check does the work likes below:
        When a packet has been started transmition,
            1) If the network interface is in napi scheduled state, we just do
        nothing as function "stmmac_poll" will call function "stmmac_tx" to finish
        the Tx completion work of the previous transmitted packet when a packet
        is received;
            2) If the network interface is NOT in napi scheduled state, then we
        start napi so that the Tx completion work of the previous transmitted
        packet will be done by function "stmmac_poll"

config STMMAC_DA
	bool "STMMAC DMA arbitration scheme"
	default n
	help
	  Selecting this option, rx has priority over Tx (only for Giga
	  Ethernet device).
	  By default, the DMA arbitration scheme is based on Round-robin
	  (rx:tx priority is 1:1).

config STMMAC_DUAL_MAC
	bool "STMMAC: dual mac support (EXPERIMENTAL)"
	default n
        depends on EXPERIMENTAL && STMMAC_ETH && !STMMAC_TIMER
	help
	  Some ST SoCs (for example the stx7141 and stx7200c2) have two
	  Ethernet Controllers. This option turns on the second Ethernet
	  device on this kind of platforms.

config STMMAC_TIMER
	bool "STMMAC Timer optimisation"
	default n
	depends on RTC_HCTOSYS_DEVICE
	help
	  Use an external timer for mitigating the number of network
	  interrupts. Currently, for SH architectures, it is possible
	  to use the TMU channel 2 and the SH-RTC device.

choice
        prompt "Select Timer device"
        depends on STMMAC_TIMER

config STMMAC_TMU_TIMER
        bool "TMU channel 2"
        depends on CPU_SH4
	help

config STMMAC_RTC_TIMER
        bool "Real time clock"
        depends on RTC_CLASS
	help

endchoice

endif
```

## kernel/drivers/net/wireless/rtl8188eus/Kconfig
```kconfig
config RTL8188EU
	tristate "Realtek 8188E USB WiFi"
	select WIRELESS_EXT
	depends on USB
	---help---
	  Help message of RTL8188EU
```

## kernel/drivers/net/wireless/rtl8723bu/Kconfig
```kconfig
config RTL8723BU
	tristate "Realtek 8723B USB WiFi"
	select WIRELESS_EXT
	depends on USB
	---help---
	  Help message of RTL8723BU
```

## kernel/sound/soc/silan/Kconfig
```kconfig
config SND_SUV_SOC_SILAN
	tristate

config SND_SUV_SOC_I2S_DLNA
	tristate

menu "IIS DAC CODEC"
config I2S_DLNA_DAC_INTRA
	bool "IIS DAC intra codec"
	select SND_SOC_SILAN_CODEC
choice
	prompt "Inner CODEC MODE"
	depends on I2S_DLNA_DAC_INTRA
config SILAN_INNER_CODEC_LINEOUT
	bool "SILAN_INNER_CODEC LINEOUT"
config SILAN_INNER_CODEC_HEADPHONE
	bool "SILAN_INNER_CODEC HEADPHONE"
endchoice

config I2S_DLNA_DAC_EXTRA
	bool "IIS DAC extra codec"
choice 
	prompt "I2S DAC CLOCK MODE"
	depends on I2S_DLNA_DAC_EXTRA
	
config I2S_DLNA_DAC_MASTER
	bool "IIS DAC master mode"
	
config I2S_DLNA_DAC_SLAVE
	bool "IIS DAC slave mode"
endchoice
endmenu

menu "IIS ADC CODEC"
config I2S_DLNA_ADC_INTRA
	bool "IIS ADC intra codec"
	select SND_SOC_SILAN_CODEC

config I2S_DLNA_ADC_EXTRA
	bool "IIS ADC extra codec"

choice 
	prompt "I2S ADC CLOCK MODE"
	depends on I2S_DLNA_ADC_EXTRA

config I2S_DLNA_ADC_MASTER
	bool "IIS DAC master mode"
	
config I2S_DLNA_ADC_SLAVE
	bool "IIS DAC slave mode"

endchoice
endmenu

config SND_SOC_SILAN_CODEC
	tristate "SILAN_INNER_CODEC"
	depends on I2S_DLNA_ADC_INTRA || I2S_DLNA_DAC_INTRA

config SND_SUV_SOC_SPDIF_IN
	tristate "SILAN SPDIF IN Drivers"

config SND_SUV_SOC_SPDIF_OUT
	tristate "SILAN SPDIF OUT Drivers"

config SND_SUV_SOC_PCM
	tristate

config SND_SILAN_SOC
	tristate "SoC Audio for the Silan SUV chips"
	depends on MIPS_SILAN_DLNA || SILAN_DLNA
	select SND_SOC_SILAN
	select SND_SUV_SOC_I2S_DLNA
	select SND_SUV_SOC_PCM
#select SND_SUV_SOC_SPDIF
	help
	  Say Y or M if you want to add support for codecs attached to
	  the I2S interface.

config SILAN_SPDIF_IN_DMA_4_BYTES
	tristate
	default y
```
